## conf/layer.conf
```bitbake
# We have a conf and classes directory, add to BBPATH
BBPATH .= ":${LAYERDIR}"

# We have recipes-* directories, add to BBFILES
BBFILES += "${LAYERDIR}/recipes-*/*/*.bb \
            ${LAYERDIR}/recipes-*/*/*.bbappend"

BBFILE_COLLECTIONS += "meta-observability"
BBFILE_PATTERN_meta-observability = "^${LAYERDIR}/"
BBFILE_PRIORITY_meta-observability = "30"

LAYERDEPENDS_meta-observability = "core"
LAYERSERIES_COMPAT_meta-observability = "scarthgap"
```
